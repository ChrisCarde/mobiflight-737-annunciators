#include "PanelGfx.h"
#include "Touch.h"

// The fonts for this board's screen: the .vlw blobs the display library parses, the
// measurements we do ourselves, and the mapping from a PanelFont role to each. All three
// are generated by tools/make_vlw.py; fonts/FontMetrics.h explains why the measurements
// are not read back out of the library.
#include "fonts/FontSet.h"

// Arduino-ESP32 calls initVariant() from initArduino(), just before setup() -- the earliest
// point application code runs. Driving the backlight low here keeps the panel dark from
// boot, even on a board with no panel configured yet whose backlight pin would otherwise be
// left to the board's hardware default until attach() ran.
extern "C" void initVariant()
{
    pinMode(Board::BACKLIGHT_PIN, OUTPUT);
    digitalWrite(Board::BACKLIGHT_PIN, LOW);
    if (Board::HAS_SHARED_SPI_TOUCH) {
        // The XPT2046 touch controller shares the display's SPI bus; park its chip select
        // high (deselected) from boot so it cannot drive MISO before the display library
        // takes the pin over.
        pinMode(Board::TOUCH_CS_PIN, OUTPUT);
        digitalWrite(Board::TOUCH_CS_PIN, HIGH);
    }
}

namespace PanelGfx
{

static Gfx::Device  s_tft     = Gfx::Device();
static PanelFont s_tftFont = FONT_SMALL; // what useFont() last loaded onto s_tft

/* Set by anything that draws, cleared when the frame reaches the panel. On the E32R32P
   this is bookkeeping for a present() that does nothing; on a board whose frame lives in
   PSRAM it is what keeps a 300KB blit from running when no lamp has changed. */
static bool s_dirty = false;
static bool     s_ready          = false;
static uint8_t  s_backlightPin   = 0;
static uint8_t  s_backlightLevel = 255;

// The three conditions for the panel to be lit. See isLit().
static bool s_running    = false; // no MobiFlight values yet -- dark from boot
static bool s_busPowered = true;  // assume powered until a bus-power output says otherwise
static bool s_powerSave  = false;

// On waking at Run, MobiFlight sends every output in one burst, in config order -- with a
// Windows timer tick (about 16 ms) before each message, so 20 outputs take 300 ms or more.
// Holding the backlight off until the burst has landed means the panel appears already
// current, and doesn't flash on if the bus-power message (last in every profile) says the
// bus is off. The bus message itself ends the wait; this is the fallback for a binding
// without one.
static const uint32_t WAKE_SETTLE_MS = 500;
static bool           s_settling     = false;
static uint32_t       s_wakeAt       = 0;

/* Handing out the screen means the caller is about to draw on it -- the only users are
   the panels' own chrome -- so this counts as a change. */
Gfx::Device &tft()
{
    s_dirty = true;
    return s_tft;
}

void push(Gfx::Canvas &canvas, int16_t x, int16_t y)
{
    if (!s_ready) return;
    canvas.pushSprite(x, y);
    s_dirty = true;
}

void present()
{
    if (!s_ready || !s_dirty) return;
    Gfx::present(s_tft);
    s_dirty = false;
}
bool      ready() { return s_ready; }

bool isLit() { return s_running && !s_settling && s_busPowered && !s_powerSave; }

// Dark is the backlight off, and nothing else: lamps keep being drawn into the panel's own
// memory while it is dark, so it comes back instantly showing the current state.
static void applyBacklight()
{
    if (!s_backlightPin) return;
    analogWrite(s_backlightPin, isLit() ? s_backlightLevel : 0);
}

bool begin(uint8_t backlightPin)
{
    s_backlightPin = backlightPin;
    if (s_backlightPin) {
        pinMode(s_backlightPin, OUTPUT);
        // Held off across init(): the ST7789 init sequence opens with fillScreen(TFT_RED)
        // (TFT_Drivers/ST7789_Init.h:10), so without this the panel flashes solid red on
        // every boot. pinMode() alone only sets direction, hence the explicit write.
        digitalWrite(s_backlightPin, LOW);
    }

    if (!s_ready) {
        Gfx::deviceBegin(s_tft);
        // The panel is natively 240x320 portrait; rotation 1 turns it into the 320x240
        // landscape the design is drawn for. If the image lands 180 degrees out relative to
        // the ribbon cable, use 3 here and in the MSG_ROTATION default.
        Gfx::deviceRotate(s_tft, Board::DEFAULT_ROTATION);
        useFont(s_tft, FONT_SMALL); // headers are drawn straight to the TFT
        s_ready = true;
    }
    s_tft.fillScreen(Theme::to565(Theme::PanelBg));
    s_dirty = true;
    applyBacklight();
    return true;
}

void setBacklight(uint8_t level)
{
    s_backlightLevel = level;
    applyBacklight();
}

void setRunning(bool running)
{
    if (running && !s_running) {
        s_settling = true;
        s_wakeAt   = millis() + WAKE_SETTLE_MS;
    }
    if (!running) s_settling = false;
    s_running = running;
    applyBacklight();
}

void tick()
{
    if (s_settling && (int32_t)(millis() - s_wakeAt) >= 0) {
        s_settling = false;
        applyBacklight();
    }
}

void setBusPowered(bool powered)
{
    s_busPowered = powered;
    s_settling   = false; // the bus state is what the settle was waiting for
    applyBacklight();
}

void setPowerSave(bool on)
{
    s_powerSave = on;
    applyBacklight();
}

void setRotation(uint8_t rotation)
{
    if (!s_ready) return;
    Gfx::deviceRotate(s_tft, rotation);
    s_dirty = true;
    Touch::setRotation(rotation); // touch coordinates turn with the picture
}

void clearPanel()
{
    if (!s_ready) return;
    s_tft.fillScreen(Theme::to565(Theme::PanelBg));
    s_dirty = true;
}

void clearRect(int16_t x, int16_t y, int16_t w, int16_t h)
{
    if (!s_ready) return;
    s_tft.fillRect(x, y, w, h, Theme::to565(Theme::PanelBg));
    s_dirty = true;
}

void drawRule(int16_t x, int16_t y, int16_t w, uint32_t colour)
{
    if (!s_ready) return;
    s_tft.drawFastHLine(x, y, w, Theme::to565(colour));
    s_dirty = true;
}

void useFont(Gfx::Device &target, PanelFont font)
{
    target.loadFont(blobOf(font));

#if ANNUN_BACKEND_TFT_ESPI
    // TFT_eSPI derives a word gap of (ascent + descent) * 2 / 7 -- 2px at 11px, which runs
    // "DC FAIL" together -- so the generator's real gap replaces it. This still matters even
    // though we measure text ourselves: the library lays out spaces inside drawString().
    target.gFont.spaceWidth = fontOf(font).spaceWidth;
#endif

    // The screen carries one font at a time and the panel chrome draws through it, so
    // remember which, for the header measurements below.
    if (&target == &s_tft) s_tftFont = font;
}

int16_t spacedTextWidth(const char *text, int16_t extraPx)
{
    return spacedWidthOf(fontOf(s_tftFont), text, extraPx);
}

void drawSpacedText(int16_t x, int16_t yMid, const char *text, uint32_t fg, int16_t extraPx)
{
    if (!s_ready || !text || !*text) return;

    // Caps occupy the capH rows above the baseline; +1 before halving keeps an odd cap
    // height from sitting a pixel high against the rule.
    const FontMetrics &fm   = fontOf(s_tftFont);
    const int16_t      base = (int16_t)(yMid + (fm.capHeight + 1) / 2);

    s_tft.setTextDatum(L_BASELINE);
    // Two-argument form: on the TFT there is no sprite pixel to read back, so anti-aliased
    // edges are blended against the known panel background instead.
    s_tft.setTextColor(Theme::to565(fg), Theme::to565(Theme::PanelBg));

    s_dirty = true;

    int16_t cx = x;
    for (const char *p = text; *p; ++p) {
        if (*p != ' ') {
            char glyph[2] = {*p, 0};
            s_tft.drawString(glyph, cx, base);
        }
        cx += advanceOf(fm, *p) + extraPx;
    }
}

void renderLamp(Gfx::Canvas &spr, const LampStyle &st, PanelFont font,
                const char *l1, const char *l2,
                bool centered, int16_t padLeft)
{
    const FontMetrics &fm = fontOf(font);

    const int16_t w = (int16_t)spr.width();
    const int16_t h = (int16_t)spr.height();

    spr.fillSprite(Theme::to565(st.bg));

    // A blank grid cell is just panel background -- no border, no legend.
    if (st.bg == Theme::PanelBg && st.edge == Theme::PanelBg) return;

    spr.drawRoundRect(0, 0, w, h, 2, Theme::to565(st.edge));

    // Stand-in for the CSS `box-shadow` halo: a 1px inner rim on lit lamps only.
    if (st.glow) {
        spr.drawRoundRect(1, 1, w - 2, h - 2, 2,
                          Theme::to565(Theme::blend(st.fg, st.bg, 38)));
    }

    if (!l1 || !*l1) return;

    // Vertical: centre the cap block. Two lines are stacked at capH + gap, with the gap about
    // half a cap height (11px: 8px caps, 4px gap, 12px pitch) so the glow copies of the two
    // lines don't touch.
    const bool    twoLine = (l2 && *l2);
    const int16_t capH    = fm.capHeight;
    const int16_t gap     = max<int16_t>(3, (int16_t)((capH + 1) / 2));
    const int16_t block   = twoLine ? (int16_t)(2 * capH + gap) : capH;
    const int16_t top     = (int16_t)((h - block) / 2);
    const int16_t base1   = (int16_t)(top + capH);
    const int16_t base2   = (int16_t)(base1 + capH + gap);

    // Horizontal: TFT_eSPI's drawGlyph treats a cursor of exactly x == 0 specially and
    // shifts the glyph by its bearing, which would misregister one glow pass against the
    // others. Keeping the cursor at >= 2 keeps every +-1 pass clear of it.
    int16_t x1 = padLeft, x2 = padLeft;
    if (centered) {
        x1 = (int16_t)((w - inkWidthOf(fm, l1)) / 2 - inkLeadOf(fm, l1));
        if (twoLine) x2 = (int16_t)((w - inkWidthOf(fm, l2)) / 2 - inkLeadOf(fm, l2));
    }
    x1 = max<int16_t>(x1, 2);
    x2 = max<int16_t>(x2, 2);

    spr.setTextDatum(L_BASELINE);

    // Stand-in for the CSS `text-shadow` glow: a dim copy offset 1px in four directions with
    // the bright glyph laid on top. The single-argument setTextColor makes a smooth font
    // blend each anti-aliased edge with the sprite pixel already underneath it, so the
    // passes composite rather than overwrite.
    if (st.glow) {
        spr.setTextColor(Theme::to565(Theme::blend(st.fg, st.bg, 110)));
        static const int8_t dx[4] = {-1, 1, 0, 0};
        static const int8_t dy[4] = {0, 0, -1, 1};
        for (uint8_t d = 0; d < 4; ++d) {
            spr.drawString(l1, x1 + dx[d], base1 + dy[d]);
            if (twoLine) spr.drawString(l2, x2 + dx[d], base2 + dy[d]);
        }
    }

    spr.setTextColor(Theme::to565(st.fg));
    spr.drawString(l1, x1, base1);
    if (twoLine) spr.drawString(l2, x2, base2);
}


/* ---- Relief ------------------------------------------------------------------------
   What makes a rectangle read as solid: a face lighter at the top than the bottom, a light
   edge along the top and left and a dark one along the bottom and right, as if lit from
   above. `sunken` turns all of that over, which is the difference between a cap standing
   proud and a window let into a faceplate.

   FIRE WARN and MASTER CAUTION are moulded caps, so they stand proud and go in when
   pressed. A six-pack is not six buttons: it is one pressable assembly with six lights
   behind a common faceplate, so the assembly stands proud and goes in, and the lights in
   it are flat.

   Kept deliberately shallow. These are small (a 72px cap at 320, 104 at 480) and the panel
   is nearly black, so a strong bevel reads as a cartoon; one pixel of edge and a gradient
   of a few percent is enough for the eye to see a button.
------------------------------------------------------------------------------------ */
static const uint8_t FACE_LIFT_LIT   = 70; // white mixed into the top of a lit face
static const uint8_t FACE_LIFT_UNLIT = 44;
static const uint8_t FACE_DEPTH      = 66; // black mixed into the bottom
static const uint8_t EDGE_HIGHLIGHT  = 130; // top and left
static const uint8_t EDGE_SHADOW     = 120; // bottom and right
static const uint8_t PRESSED_DARKEN  = 34;  // black mixed into a face that has been pushed in

/* `gradient` is off for a plate: an assembly's face is one uniform surface with lights set
   flush into it, and its depth is in the raised edge round it. A gradient across it would
   show every flat light as a box that is darker at the top and lighter at the bottom. */
template <class Target>
static void reliefFace(Target &spr, int16_t x, int16_t y, int16_t w, int16_t h,
                       int16_t r, uint32_t face, bool lit, bool sunken, bool gradient = true)
{
    if (w <= 2 || h <= 2) return;

    // Held down: the light comes from the same place, so a cap that has moved into its
    // bezel is shaded the other way round and sits a shade darker overall.
    if (sunken) face = Theme::blend(0x000000, face, PRESSED_DARKEN);

    spr.fillRoundRect(x, y, w, h, r, Theme::to565(face));

    // The gradient, drawn as rows inside the rounded outline. Rows within the corner
    // radius are inset so they do not square the corners off again.
    const int16_t  mid  = (int16_t)(h / 2);
    const uint8_t  lift = lit ? FACE_LIFT_LIT : FACE_LIFT_UNLIT;
    for (int16_t i = 1; gradient && i < h - 1; ++i) {
        const int16_t edge   = min<int16_t>(i, (int16_t)(h - 1 - i));
        const int16_t inset  = (int16_t)(edge < r ? 1 + (r - edge) : 1);
        const int16_t run    = (int16_t)(w - 2 * inset);
        if (run <= 0) continue;
        uint32_t colour = face;
        const int16_t from = sunken ? (int16_t)(h - 1 - i) : i; // the gradient flips when sunken
        if (from < mid && lift)
            colour = Theme::blend(0xFFFFFF, face, (uint8_t)(lift * (mid - from) / mid));
        else if (from >= mid && FACE_DEPTH)
            colour = Theme::blend(0x000000, face,
                                  (uint8_t)(FACE_DEPTH * (from - mid) / max<int16_t>(1, h - 1 - mid)));
        else
            continue;
        spr.drawFastHLine((int32_t)(x + inset), (int32_t)(y + i), run, Theme::to565(colour));
    }

    // The lit and shadowed edges. Inset by the radius at each end so they stop short of
    // the corners rather than cutting across them.
    /* The edges. Thickness follows the cap: one pixel on a 68px push-light at 320, two on
       a 100px one at 480, which is what keeps the relief looking the same size in the hand
       rather than half as deep on the bigger screen. The second pixel is drawn at half
       strength so the edge rolls off instead of ending in a hard line. */
    const int16_t bevel = (int16_t)max<int16_t>(1, (int16_t)(min<int16_t>(w, h) / 40));
    for (int16_t b = 0; b < bevel; ++b) {
        const uint8_t  fade  = (uint8_t)(b == 0 ? 255 : 128);
        const uint32_t upper = Theme::blend(sunken ? 0x000000 : 0xFFFFFF, face,
                                            (uint8_t)((sunken ? EDGE_SHADOW : EDGE_HIGHLIGHT) * fade / 255));
        const uint32_t lower = Theme::blend(sunken ? 0xFFFFFF : 0x000000, face,
                                            (uint8_t)((sunken ? EDGE_HIGHLIGHT : EDGE_SHADOW) * fade / 255));
        const int16_t  ins   = (int16_t)(r + 1 + b);
        const int16_t  hRun  = (int16_t)(w - 2 * ins);
        const int16_t  vRun  = (int16_t)(h - 2 * ins);
        if (hRun > 0) {
            spr.drawFastHLine(x + ins, (int32_t)(y + b), hRun, Theme::to565(upper));
            spr.drawFastHLine(x + ins, (int32_t)(y + h - 1 - b), hRun, Theme::to565(lower));
        }
        if (vRun > 0) {
            spr.drawFastVLine((int32_t)(x + b), y + ins, vRun, Theme::to565(upper));
            spr.drawFastVLine((int32_t)(x + w - 1 - b), y + ins, vRun, Theme::to565(lower));
        }
    }
}

void renderLampLines(Gfx::Canvas &spr, const LampStyle &st,
                     const LegendLine *lines, uint8_t count, PanelFont &loaded, bool pressed)
{
    const int16_t w = (int16_t)spr.width();
    const int16_t h = (int16_t)spr.height();

    switch (st.kind) {
    case KIND_FILLED:
        // A push-light: a dark bezel two pixels deep round a moulded cap that lights right
        // across. The cap is raised -- see raisedFace().
        spr.fillSprite(Theme::to565(st.edge));
        // The bezel is shaded the opposite way to the cap, which is what makes the cap read
        // as standing proud of it rather than as a picture of a button.
        spr.drawFastHLine(0, 0, w, Theme::to565(Theme::blend(0x000000, st.edge, 90)));
        spr.drawFastVLine(0, 0, h, Theme::to565(Theme::blend(0x000000, st.edge, 90)));
        spr.drawFastHLine(0, (int32_t)(h - 1), w, Theme::to565(Theme::blend(0xFFFFFF, st.edge, 60)));
        spr.drawFastVLine((int32_t)(w - 1), 0, h, Theme::to565(Theme::blend(0xFFFFFF, st.edge, 60)));
        reliefFace(spr, 2, 2, (int16_t)(w - 4), (int16_t)(h - 4), 2, st.bg, st.glow, pressed);
        break;
    case KIND_LEGEND:
        // A light in an assembly's faceplate. It is flat: the relief belongs to the assembly,
        // which is the thing that is pressed, and giving each light its own would make six
        // buttons of what is one. When the assembly is pressed the legend still moves with
        // it -- see `shove` below.
        // Flush with the face, so it darkens with it when the assembly is pushed in.
        spr.fillSprite(Theme::to565(pressed ? Theme::blend(0x000000, st.bg, PRESSED_DARKEN) : st.bg));
        break;
    case KIND_LENS:
    default:
        spr.fillSprite(Theme::to565(st.bg));
        if (st.bg == Theme::PanelBg && st.edge == Theme::PanelBg) return; // blank cell
        spr.drawRoundRect(0, 0, w, h, 2, Theme::to565(st.edge));
        if (st.glow) {
            spr.drawRoundRect(1, 1, w - 2, h - 2, 2,
                              Theme::to565(Theme::blend(st.fg, st.bg, 38)));
        }
        break;
    }

    if (count > 4) count = 4;
    while (count && (!lines[count - 1].text || !*lines[count - 1].text)) --count;
    if (!count) return;

    // The same vertical rhythm as renderLamp(): caps centred as a block, lines apart by
    // about half a cap height. A change of size gets two pixels more, so small print reads
    // as a separate line rather than a cramped third one.
    int16_t caps[4], gaps[4] = {0, 0, 0, 0}, block = 0;
    for (uint8_t i = 0; i < count; ++i) {
        caps[i] = fontOf(lines[i].font).capHeight;
        block += caps[i];
        if (i + 1 < count) {
            gaps[i] = max<int16_t>(3, (int16_t)((caps[i] + 1) / 2));
            if (lines[i + 1].font != lines[i].font) gaps[i] += 2;
            block += gaps[i];
        }
    }

    // A legend lit dark on a lit face (FILLED) takes no halo: a darker copy round dark
    // letters would only smear them.
    const bool halo = st.glow && st.kind != KIND_FILLED;

    spr.setTextDatum(L_BASELINE);
    // The legend is printed on the cap, so it moves with it -- a pixel down and right.
    const int16_t shove = pressed ? 1 : 0;
    int16_t       base  = (int16_t)((h - block) / 2 + shove);
    for (uint8_t i = 0; i < count; ++i) {
        base += caps[i];
        if (lines[i].text && *lines[i].text) {
            if (lines[i].font != loaded) {
                spr.unloadFont();
                useFont(spr, lines[i].font);
                loaded = lines[i].font;
            }
            const FontMetrics &fm = fontOf(lines[i].font);
            // >= 2: see renderLamp() on TFT_eSPI's special case for a cursor at x == 0.
            const int16_t x = max<int16_t>(
                (int16_t)((w - inkWidthOf(fm, lines[i].text)) / 2 - inkLeadOf(fm, lines[i].text) + shove), 2);
            if (halo) {
                spr.setTextColor(Theme::to565(Theme::blend(st.fg, st.bg, 110)));
                spr.drawString(lines[i].text, x - 1, base);
                spr.drawString(lines[i].text, x + 1, base);
                spr.drawString(lines[i].text, x, base - 1);
                spr.drawString(lines[i].text, x, base + 1);
            }
            spr.setTextColor(Theme::to565(st.fg));
            spr.drawString(lines[i].text, x, base);
        }
        base += gaps[i];
    }
}

void drawPlate(int16_t x, int16_t y, int16_t w, int16_t h, int16_t radius,
               uint32_t fill, uint32_t edge, bool raised, bool pressed)
{
    if (!s_ready) return;
    if (raised) {
        // Something you press -- a six-pack: a uniform face with a raised edge round it.
        reliefFace(s_tft, x, y, w, h, radius, fill, false, pressed, false);
    } else {
        // A bezel that only holds lights, like the flight-control clusters: flat, as drawn
        // before any of this. Relief here would suggest a button that is not there.
        s_tft.fillRoundRect(x, y, w, h, radius, Theme::to565(fill));
    }
    s_tft.drawRoundRect(x, y, w, h, radius, Theme::to565(edge));
    s_dirty = true;
}

void drawRing(int16_t x, int16_t y, int16_t w, int16_t h, int16_t inset, uint32_t colour)
{
    if (!s_ready) return;
    s_tft.drawRoundRect(x - inset, y - inset, w + 2 * inset, h + 2 * inset, 3, Theme::to565(colour));
    s_dirty = true;
}

} // namespace PanelGfx
